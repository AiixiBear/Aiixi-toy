
#define toolbar_height 17 // height of the toolbar area (app name, WebUI/WiFi/BT status, battery)

#define battery_width 20
#define battery_height 10
#define batt_margin 2
#define batt_border 2

// Bluetooth rune, drawn bare (no tab frame) so it reads as a status indicator
// next to the battery rather than as another menu tab.
#define bt_icon_width 7
#define bt_icon_height 13

PROGMEM const unsigned char BT_bits[13] = {
    0x08,   // ...#...
    0x18,   // ...##..
    0x28,   // ...#.#.
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    0x18,   // ...##..
    0x08    // ...#...
};

// WiFi and WebUI (globe) status icons, same XBitmap style as the BT
// rune. Drawn left of the BT icon in the toolbar (see drawNetStatus).
#define net_icon_width 11
#define net_icon_height 13

PROGMEM const unsigned char WIFI_bits[26] = {
    0x00, 0x00, 0x00, 0x00, 0xf8, 0x00,
    0x06, 0x03, 0x02, 0x02, 0x00, 0x00,
    0xf8, 0x00, 0x04, 0x01, 0x00, 0x00,
    0x20, 0x00, 0x70, 0x00, 0x20, 0x00,
    0x00, 0x00
};

PROGMEM const unsigned char WEB_bits[26] = {
    0x00, 0x00, 0x00, 0x00, 0xf8, 0x00,
    0x24, 0x01, 0x22, 0x02, 0x22, 0x02,
    0xfe, 0x03, 0x22, 0x02, 0x22, 0x02,
    0x24, 0x01, 0xf8, 0x00, 0x00, 0x00,
    0x00, 0x00
};



#define wait_icon_width 40
#define wait_icon_height 40
static unsigned char wait_icon[] = {
  0x00, 0x00, 0x00, 0x00, 0x00, 0x00, 0x00, 0x00, 0x00, 0x00, 0x00, 0x00,
  0x00, 0x00, 0x00, 0x00, 0x00, 0x00, 0x00, 0x00, 0x00, 0x00, 0x00, 0x00,
  0x00, 0x00, 0x00, 0x00, 0x00, 0x00, 0x00, 0x00, 0x00, 0x00, 0x00, 0x00,
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  0x00, 0x00, 0x00, 0x00, 0x00, 0x00, 0x00, 0x00
};



#define logoapp_width 52
#define logoapp_height 52
static unsigned char logoapp_bits[] = {
  0xff, 0xff, 0xff, 0xff, 0xff, 0xff, 0xff, 0xff, 0x01, 0x00, 0x00, 0x00,
  0xf8, 0xff, 0x7f, 0x00, 0x00, 0x00, 0x00, 0xc0, 0xff, 0x1f, 0xff, 0xff,
  0xff, 0xff, 0x8f, 0xff, 0x8f, 0xff, 0xff, 0xff, 0xff, 0x3f, 0xff, 0xe7,
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  0xff, 0xff, 0xff, 0xff
};

void show_wait_icon() {
  M5.Lcd.drawXBitmap(60, 22, wait_icon, wait_icon_width, wait_icon_height, txt_color, bg_color);
}

void clear_wait_icon() {
  M5.Lcd.fillRect(60, 22, wait_icon_width, wait_icon_height, bg_color);
}

void drawBattery() {
  // Cache the integer level: the toolbar tick calls this every loop, and
  // redrawing identical rectangles every iteration is wasted work. The
  // level also drives the low-battery colour, so a redraw on change
  // covers both.
  static int lastLevel = -1;
  int batteryLevelInt = (int)M5.Power.getBatteryLevel();
  if (batteryLevelInt == lastLevel) {
    return;
  }
  lastLevel = batteryLevelInt;
  float batteryLevel = (float)batteryLevelInt;

  // draw the outer base rectangle with white color, the inner rectangle with black color,
  // then fill the inner rectangle with greencolor with the battery level
  int batteryLevelWidth = (int)(batteryLevel / 100.0 * (battery_width - batt_border));

  int batt_x = screen_x - battery_width - batt_margin;
  int batt_y = batt_margin;

  int batt_color = batteryLevel < 20 ? TFT_RED : TFT_GREEN;

  M5.Lcd.drawRect(batt_x, batt_y, battery_width, battery_height, txt_color);
  M5.Lcd.fillRect(batt_x + 1, batt_y + 1, battery_width - batt_border, battery_height - batt_border, bg_color);

  M5.Lcd.fillRect(batt_x + 1, batt_y + 1, batteryLevelWidth, battery_height - batt_border, batt_color);

}

// Toolbar: current app name on the left; WebUI, WiFi, BT status icons
// and the battery on the right. Only redraws the name when it changes,
// so the per-loop tick can call it freely. The name area stops before
// the status icons on both screen sizes (on the 160px screen the icons
// start at x=100, on the 240px screen at x=180).
void drawBTStatus();  // defined below; the toolbar calls it every tick
void drawNetStatus(); // defined below; the toolbar calls it every tick
void drawAppToolbar() {
  static String lastName = "";
  if (currentAppName != lastName) {
    int nameWidth = screen_x - 62;
    if (nameWidth > 120) {
      nameWidth = 120;
    }
    M5.Lcd.fillRect(0, 0, nameWidth, toolbar_height, bg_color);
    M5.Lcd.setFont(&beta5pt7b);
    M5.Lcd.setTextColor(txt_color, bg_color);
    M5.Lcd.setCursor(3, 5);
    M5.Lcd.print(currentAppName);
    lastName = currentAppName;
  }
  drawNetStatus();
  drawBTStatus();
  drawBattery();
}

// Status icon colour for "running but not connected" states.
#define STATUS_DIM 0x7BEF

// Bluetooth icon in the toolbar, left of the battery. Three states:
// bright while a host is connected (codes can be typed), dim while
// BLE is on but no host is connected, hidden while BLE is off.
void drawBTStatus() {
  static int last_state = -1;

  int state = 0;
  if (ble_hid_started && ble_hid_enabled) {
    state = bleHidConnected() ? 2 : 1;
  }
  if (state == last_state) {
    return;
  }
  last_state = state;

  int bt_x = screen_x - battery_width - batt_margin - bt_icon_width - 3;
  int bt_y = (toolbar_height - bt_icon_height) / 2;   // centred in the toolbar row

  if (state == 0) {
    M5.Lcd.fillRect(bt_x, bt_y, bt_icon_width, bt_icon_height, bg_color);
  } else {
    uint16_t btColor = (state == 2) ? txt_color : (uint16_t)STATUS_DIM;
    M5.Lcd.drawXBitmap(bt_x, bt_y, BT_bits, bt_icon_width, bt_icon_height, btColor, bg_color);
  }
}

// WiFi and WebUI status icons, left of the BT icon in the order
// [WebUI] [WiFi] [BT] [battery]. WiFi: bright while a station link is
// up, dim while the radio is on without one (AP mode, or still
// connecting), hidden while the radio is off. WebUI (globe): shown
// while the background WebUI service is running.
void drawNetStatus() {
  static int lastWifiState = -1;
  static int lastWebState = -1;

  int net_y = (toolbar_height - net_icon_height) / 2;
  int wifi_x = screen_x - battery_width - batt_margin - bt_icon_width - 3 - net_icon_width - 3;
  int web_x = wifi_x - net_icon_width - 3;

  wifi_mode_t mode = WiFi.getMode();
  int wifiState = 0;
  if (mode == WIFI_STA && WiFi.status() == WL_CONNECTED) {
    wifiState = 2;
  } else if (mode != WIFI_OFF) {
    wifiState = 1;
  }
  if (wifiState != lastWifiState) {
    lastWifiState = wifiState;
    if (wifiState == 0) {
      M5.Lcd.fillRect(wifi_x, net_y, net_icon_width, net_icon_height, bg_color);
    } else {
      uint16_t wifiColor = (wifiState == 2) ? txt_color : (uint16_t)STATUS_DIM;
      M5.Lcd.drawXBitmap(wifi_x, net_y, WIFI_bits, net_icon_width, net_icon_height, wifiColor, bg_color);
    }
  }

  int webState = webuiBgActive() ? 1 : 0;
  if (webState != lastWebState) {
    lastWebState = webState;
    if (webState == 0) {
      M5.Lcd.fillRect(web_x, net_y, net_icon_width, net_icon_height, bg_color);
    } else {
      M5.Lcd.drawXBitmap(web_x, net_y, WEB_bits, net_icon_width, net_icon_height, txt_color, bg_color);
    }
  }
}

// Per-loop tick for an app: keeps button state fresh, powers off after
// the inactivity timeout, refreshes the toolbar, and reports whether the
// user asked to leave the app (BtnB held). Replaces the old
// switchscreen(), which cycled screens on a short BtnB press; screen
// switching is now the home screen's job.
bool appExitRequested() {
  unsigned long currentMillis = millis();
  if (currentMillis - previousMillis >= timeout_ScreenOn) {
    M5.Power.powerOff();
  }
  M5.update();
  drawAppToolbar();
  // Background WebUI tick: every app loop runs through here, so the
  // server keeps being served while any app is open.
  webuiBgTick();
  if (M5.BtnB.wasHold()) {
    previousMillis = currentMillis;
    return true;
  }
  return false;
}

